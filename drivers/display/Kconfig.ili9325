## drivers/display/Kconfig.ili9325
```kconfig
# ILI9325 display driver configuration options

# Copyright (c) 2024 Andrea Merello <andrea.merello@gmail.com>

# Based on Kconfig.ili9xxx which is:
#  Copyright (c) 2017 Jan Van Winkel <jan.van_winkel@dxplore.eu>
#  Copyright (c) 2020 Teslabs Engineering S.L.
#  Copyright (c) 2021 Krivorot Oleg <krivorot.oleg@gmail.com>

# SPDX-License-Identifier: Apache-2.0

config ILI9325
	bool "ILI9325 display driver"
	default y
	depends on DT_HAS_ILITEK_ILI9325_ENABLED
	select MIPI_DBI
	help
	  Enable driver for ILI9325 display driver.
```

## dts/bindings/display/ilitek,ili9325.yaml
```yaml
# Copyright (c) 2024, Andrea Merello <andrea.merello@gmail.com>
# Based on ilitek,ili9340.yaml which is:
#  Copyright (c) 2018, Jan Van Winkel <jan.van_winkel@dxplore.eu>
#  Copyright (c) 2020, Teslabs Engineering S.L.
# SPDX-License-Identifier: Apache-2.0

description: ILI9325 display controllers common properties.

include: [mipi-dbi-spi-device.yaml, display-controller.yaml]

compatible: "ilitek,ili9325"
```
